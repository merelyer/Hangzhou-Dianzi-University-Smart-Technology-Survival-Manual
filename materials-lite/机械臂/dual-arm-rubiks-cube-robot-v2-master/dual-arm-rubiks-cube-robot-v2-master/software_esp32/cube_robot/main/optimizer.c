#include <stdio.h>
#include <stdlib.h>
#include <stdint.h>
#include <string.h>
#include <stdbool.h>
#include <limits.h>

#include "esp_log.h"
#include "optimizer.h"

// 调试宏定义
static const char *TAG = "optimizer";

// 手臂侧定义
typedef enum {
    LEFT = 1,
    RIGHT = 2
} ArmSide;

// 状态字符串列表
const char state_str_list[24][2] = {
    {'D','F'}, {'D','B'}, {'D','L'}, {'D','R'}, 
    {'U','F'}, {'U','B'}, {'U','L'}, {'U','R'},
    {'F','L'}, {'F','R'}, {'F','U'}, {'F','D'}, 
    {'B','L'}, {'B','R'}, {'B','U'}, {'B','D'},
    {'L','F'}, {'L','B'}, {'L','U'}, {'L','D'}, 
    {'R','F'}, {'R','B'}, {'R','U'}, {'R','D'}
};

// 全局变量，翻转序列耗时（初始化时计算），单位ms
typedef struct {
    int16_t arm_back;   // "R2 R+N R0"
    int16_t rotate_90;  // "R+T"
    int16_t rotate_180; // "R*T"
} TimeCost;
int16_t flip_sequence_time[83];
TimeCost other_sequence_time;
bool time_data_init = false;
// 翻转序列池（消耗时间，动作序列），不含时间
// 数据使用https://gitee.com/hemn1990/two-arm-two-phase/blob/master/tools/cube_optimizer_v2.py自动生成，不建议手工修改
const char *flip_sequences[83] = {
    "",
    "R1 L+F R0 ",
    "R1 L*F R0 ",
    "R1 L-F R0 ",
    "L1 R+F L0 ",
    "L1 R*F L0 ",
    "L1 R-F L0 ",
    "R1 L+F R0 L2 L+N R+F L0 ",
    "R1 L+F R0 L2 L+N R*F L0 ",
    "R1 L+F R0 L2 L+N R-F L0 ",
    "R1 L*F R0 L1 R+F L0 ",
    "R1 L*F R0 L1 R*F L0 ",
    "R1 L*F R0 L1 R-F L0 ",
    "R1 L-F R0 L2 L+N R+F L0 ",
    "R1 L-F R0 L2 L+N R*F L0 ",
    "R1 L-F R0 L2 L+N R-F L0 ",
    "L1 R+F L0 R2 R+N L+F R0 ",
    "L1 R+F L0 R2 R+N L*F R0 ",
    "L1 R+F L0 R2 R+N L-F R0 ",
    "L1 R*F L0 R1 L+F R0 ",
    "L1 R*F L0 R1 L-F R0 ",
    "L1 R-F L0 R2 R+N L+F R0 ",
    "L1 R-F L0 R2 R+N L*F R0 ",
    "L1 R-F L0 R2 R+N L-F R0 ",
    "R2 R+N R0 ",
    "R2 R+N L+F R0 ",
    "R2 R+N L*F R0 ",
    "R2 R+N L-F R0 ",
    "R2 R+N L+F R0 L2 L+N R+F L0 ",
    "R2 R+N L+F R0 L2 L+N R*F L0 ",
    "R2 R+N L+F R0 L2 L+N R-F L0 ",
    "R2 R+N L*F R0 L1 R+F L0 ",
    "R2 R+N L*F R0 L1 R*F L0 ",
    "R2 R+N L*F R0 L1 R-F L0 ",
    "R2 R+N L-F R0 L2 L+N R+F L0 ",
    "R2 R+N L-F R0 L2 L+N R*F L0 ",
    "R2 R+N L-F R0 L2 L+N R-F L0 ",
    "L1 R+F L0 R1 L+F R0 ",
    "L1 R+F L0 R1 L*F R0 ",
    "L1 R+F L0 R1 L-F R0 ",
    "L1 R*F L0 R2 R+N L+F R0 ",
    "L1 R*F L0 R2 R+N L-F R0 ",
    "L1 R-F L0 R1 L+F R0 ",
    "L1 R-F L0 R1 L*F R0 ",
    "L1 R-F L0 R1 L-F R0 ",
    "L2 L+N L0 ",
    "L2 L+N R+F L0 ",
    "L2 L+N R*F L0 ",
    "L2 L+N R-F L0 ",
    "R1 L+F R0 L1 R+F L0 ",
    "R1 L+F R0 L1 R*F L0 ",
    "R1 L+F R0 L1 R-F L0 ",
    "R1 L*F R0 L2 L+N R+F L0 ",
    "R1 L*F R0 L2 L+N R*F L0 ",
    "R1 L*F R0 L2 L+N R-F L0 ",
    "R1 L-F R0 L1 R+F L0 ",
    "R1 L-F R0 L1 R*F L0 ",
    "R1 L-F R0 L1 R-F L0 ",
    "L2 L+N R+F L0 R2 R+N L+F R0 ",
    "L2 L+N R+F L0 R2 R+N L*F R0 ",
    "L2 L+N R+F L0 R2 R+N L-F R0 ",
    "L2 L+N R*F L0 R1 L+F R0 ",
    "L2 L+N R*F L0 R1 L-F R0 ",
    "L2 L+N R-F L0 R2 R+N L+F R0 ",
    "L2 L+N R-F L0 R2 R+N L*F R0 ",
    "L2 L+N R-F L0 R2 R+N L-F R0 ",
    "R2 R+N L+F R0 L1 R+F L0 ",
    "R2 R+N L+F R0 L1 R*F L0 ",
    "R2 R+N L+F R0 L1 R-F L0 ",
    "R2 R+N L*F R0 L2 L+N R+F L0 ",
    "R2 R+N L*F R0 L2 L+N R*F L0 ",
    "R2 R+N L*F R0 L2 L+N R-F L0 ",
    "R2 R+N L-F R0 L1 R+F L0 ",
    "R2 R+N L-F R0 L1 R*F L0 ",
    "R2 R+N L-F R0 L1 R-F L0 ",
    "L2 L+N R+F L0 R1 L+F R0 ",
    "L2 L+N R+F L0 R1 L*F R0 ",
    "L2 L+N R+F L0 R1 L-F R0 ",
    "L2 L+N R*F L0 R2 R+N L+F R0 ",
    "L2 L+N R*F L0 R2 R+N L-F R0 ",
    "L2 L+N R-F L0 R1 L+F R0 ",
    "L2 L+N R-F L0 R1 L*F R0 ",
    "L2 L+N R-F L0 R1 L-F R0 "
};

// 96x96翻转表
const int8_t flip_table[96][96] = {
    {0,-1,-1,-1,2,-1,-1,-1,-1,-1,1,-1,-1,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16,-1},
    {24,0,-1,-1,26,-1,-1,-1,-1,-1,25,-1,-1,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37,-1},
    {45,-1,0,-1,-1,-1,2,-1,1,-1,-1,-1,3,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58,-1},
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    {-1,74,-1,-1,-1,66,-1,-1,-1,-1,-1,-1,-1,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24,0}
};

int init_time_table(int (*get_motion_time)(const char*)) {
    // 初始化翻转序列时间数组
    for (int i = 0; i < 83; i++) {
        int time = get_motion_time(flip_sequences[i]);
        if (time < 0 || time > 32768){
            ESP_LOGE(TAG, "计算执行时间失败：%s", flip_sequences[i]);
            return -1;
        }
        flip_sequence_time[i] = (int16_t)time;
    }

    // 初始化其他动作序列时间
    const char *other[3] = {"R2 R+N R0 ", "R+T ", "R*T "};
    int16_t other_time[3];
    for (int i = 0; i < 3; i++) {
        int time = get_motion_time(other[i]);
        if (time < 0 || time > 32768){
            ESP_LOGE(TAG, "计算执行时间失败：%s", flip_sequences[i]);
            return -1;
        }
        other_time[i] = (int16_t)time;
    }


    other_sequence_time.arm_back = other_time[0];
    other_sequence_time.rotate_90 = other_time[1];
    other_sequence_time.rotate_180 = other_time[2];

    time_data_init = true;  // 标记初始化完成
    return 0;
}


// 查找状态索引
static int find_state_index(const char* state_str) {
    for (int i = 0; i < 24; i++) {
        if (state_str_list[i][0] == state_str[0] && state_str_list[i][1] == state_str[1]) {
            return i;
        }
    }
    return -1;
}

// 编码状态
static int encode_state(const char* state_str, const bool l_arm, const bool r_arm) {
    int state_idx = find_state_index(state_str);
    if (state_idx == -1) {
        ESP_LOGE(TAG, "未知的状态字符串: %s", state_str);
        return -1;
    }
    return (state_idx << 2) | (l_arm << 1) | r_arm;
}

// 解码状态
static void decode_state(const int8_t state_int, char* state_str, bool* l_arm, bool* r_arm) {
    int8_t state_idx = state_int >> 2;
    if (state_idx >= 24) {
        ESP_LOGE(TAG, "未知的状态编码: %d", state_int);
        state_idx = 0;
    }
    *l_arm = (state_int >> 1) & 1;
    *r_arm = state_int & 1;
    state_str[0] = state_str_list[state_idx][0];
    state_str[1] = state_str_list[state_idx][1];
    state_str[2] = 0;
}

// 计算旋转操作的时间和状态变化
// output_sequence的长度至少为14
// 如果不需要返回字符串，可以设置os = 0
static int calculate_twist_time_and_state(const int8_t state_int, const char* action_str, 
                    int8_t* new_state_int, char* os) {
    char state_str[3];
    bool l_arm, r_arm;
    decode_state(state_int, state_str, &l_arm, &r_arm);
    
    char face = action_str[0];
    char modifier = action_str[1]; // 可能为'\0'、'\''或'2'

    int time_cost = 0;
    ArmSide arm_side;
    // 确定使用哪只手臂
    if (state_str[0] == face) {
        arm_side = LEFT;
    } else if (state_str[1] == face) {
        arm_side = RIGHT;
    } else {
        // ESP_LOGI(TAG, "状态 %d (%s) 无法操作目标面 %c", state_int, state_str, face);
        return -1;
    }
    
    // 检查是否需要空转操作
    if (arm_side == LEFT && r_arm) {
        if(os) strcat(os, "R2 R+N R0 ");
        time_cost += other_sequence_time.arm_back;
        r_arm = false;
    } else if (arm_side == RIGHT && l_arm) {
        if(os) strcat(os, "L2 L+N L0 ");
        time_cost += other_sequence_time.arm_back;
        l_arm = false;
    }

    // 根据修饰符确定旋转类型
    if (arm_side == LEFT) {
        if (modifier == '\'') {  // 逆时针90°
            if(os) strcat(os, "L-T ");
            time_cost += other_sequence_time.rotate_90;
            l_arm = !l_arm;
        } else if (modifier == '2') {  // 180°
            if(os) strcat(os, "L*T ");
            time_cost += other_sequence_time.rotate_180;
        } else {  // 顺时针90°
            if(os) strcat(os, "L+T ");
            time_cost += other_sequence_time.rotate_90;
            l_arm = !l_arm;
        }
    } else {  // 右臂操作
        if (modifier == '\'') {  // 逆时针90°
            if(os) strcat(os, "R-T ");
            time_cost += other_sequence_time.rotate_90;
            r_arm = !r_arm;
        } else if (modifier == '2') {  // 180°
            if(os) strcat(os, "R*T ");
            time_cost += other_sequence_time.rotate_180;
        } else {  // 顺时针90°
            if(os) strcat(os, "R+T ");
            time_cost += other_sequence_time.rotate_90;
            r_arm = !r_arm;
        }
    }

    *new_state_int = encode_state(state_str, l_arm, r_arm);
    return time_cost;
}

// 动态规划状态结构
typedef struct {
    int8_t prev_state;
    int8_t mid_state;  // 新增字段：翻面后的状态
    int8_t flip_index;
    int8_t valid;
    int16_t time;
} DPState;

// 优化动作序列（带详细调试信息）
// 优化动作序列（使用状态跟踪代替完整序列存储）
static int cube_tweak_str_time(int8_t initial_state, const char* action_str, 
                        char* output_sequence, int8_t* final_state) {
    // 解析动作字符串
    char actions[MAX_ACTIONS][3];
    int action_count = 0;
    const char* p = action_str;
    
    while (*p && action_count < MAX_ACTIONS) {
        // 跳过空格
        while (*p == ' ') p++;
        if (!*p) break;
        
        // 获取动作面
        char face = *p++;
        actions[action_count][0] = face;
        
        // 获取修饰符（如果存在）
        if (*p == '\'' || *p == '2') {
            actions[action_count][1] = *p++;
            actions[action_count][2] = '\0';
        } else {
            actions[action_count][1] = '\0';
            actions[action_count][2] = '\0';
        }
        
        action_count++;
        //ESP_LOGI(TAG, "解析动作 %d: %s", action_count, actions[action_count-1]);
    }

    // 分配DP表内存（使用修改后的DPState结构）
    int dp_size = (action_count + 1) * sizeof(DPState) * MAX_DP_STATES;
    //ESP_LOGI(TAG, "分配内存 %.1f KB", dp_size/1024.0f);
    DPState (*dp)[MAX_DP_STATES] = malloc(dp_size);
    if (!dp) {
        ESP_LOGE(TAG, "内存分配失败");
        return -1;
    }
    
    // 初始化DP表
    for (int i = 0; i <= action_count; i++) {
        for (int j = 0; j < MAX_DP_STATES; j++) {
            dp[i][j].time = SHRT_MAX;
            dp[i][j].prev_state = -1;
            dp[i][j].mid_state = -1;
            dp[i][j].flip_index = -1;
            dp[i][j].valid = false;
        }
    }
    
    // 初始状态
    dp[0][initial_state].time = 0;
    dp[0][initial_state].prev_state = -1;
    dp[0][initial_state].mid_state = -1;
    dp[0][initial_state].flip_index = -1;
    dp[0][initial_state].valid = true;
    
    // DP处理每个动作
    for (int step = 0; step < action_count; step++) {
        for (int state = 0; state < MAX_DP_STATES; state++) {
            if (!dp[step][state].valid) continue;
            
            //ESP_LOGI(TAG, "  当前状态: %d, 累计时间: %d", state, dp[step][state].time);
            
            // 尝试所有可能的翻面路径 (包括不翻面)
            for (int target_state = 0; target_state < MAX_DP_STATES; target_state++) {
                int8_t seq_index = flip_table[state][target_state];
                if (seq_index == -1) continue;
                
                int flip_time = flip_sequence_time[seq_index];
                // ESP_LOGI(TAG, "    考虑翻面到 %d (序列 %s)", target_state, flip.sequence);
                // 在目标状态下尝试旋转
                int8_t flip_twist_new_state;
                int flip_twist_time = calculate_twist_time_and_state(
                    target_state, actions[step], &flip_twist_new_state, NULL);
                
                if (flip_twist_time >= 0) {
                    int total_time = dp[step][state].time + flip_time + flip_twist_time;
                    
                    if (total_time < dp[step+1][flip_twist_new_state].time) {
                        dp[step+1][flip_twist_new_state].time = total_time;
                        dp[step+1][flip_twist_new_state].prev_state = state;
                        dp[step+1][flip_twist_new_state].mid_state = target_state;  // 存储中间状态
                        dp[step+1][flip_twist_new_state].flip_index = seq_index;
                        dp[step+1][flip_twist_new_state].valid = true;
                        //ESP_LOGI(TAG, "    翻面到%-2d状态 (序列 %-30s) 旋转到%-2d状态, 总时间 %-4d",
                        //         target_state, flip.sequence, flip_twist_new_state, total_time);
                    }
                }
            }
        }
    }
    
    // 查找最优解
    int min_time = INT_MAX;
    int8_t best_state = -1;
    
    for (int state = 0; state < MAX_DP_STATES; state++) {
        if (dp[action_count][state].valid && dp[action_count][state].time < min_time) {
            min_time = dp[action_count][state].time;
            best_state = state;
        }
    }
    
    if (best_state == -1) {
        ESP_LOGE(TAG, "未找到有效路径");
        free(dp);
        return -1;
    }
    
    // 回溯构建序列
    // calculate_twist_time_and_state最长14
    // flip_sequences[flip_index].sequence最长28
    // 14+28+1=43，此处取64
    int8_t current_state = best_state;
    char step_seqs[MAX_ACTIONS][64] = {0};
    int step_count = 0;
    
    for (int step = action_count; step >= 1; step--) {
        int8_t mid_state = dp[step][current_state].mid_state;
        int8_t prev_state = dp[step][current_state].prev_state;
        int8_t flip_index = dp[step][current_state].flip_index;
        char *p_str = step_seqs[step_count];
        p_str[0] = '\0';
        // 写入翻面操作步骤
        if (flip_index != -1) {
            strcpy(p_str, flip_sequences[flip_index]);
        }
        // 在末尾追加旋转操作步骤
        int8_t temp_state;
        calculate_twist_time_and_state(mid_state, actions[step-1], &temp_state, p_str);
        
        step_count++;
        current_state = prev_state;
    }
    
    // 按正确顺序拼接序列
    for (int i = step_count - 1; i >= 0; i--) {
        strcat(output_sequence, step_seqs[i]);
    }
    
    *final_state = best_state;
    //ESP_LOGI(TAG, "最优状态: %d, 总时间: %d", best_state, min_time);
    free(dp);
    return min_time;
}
// 调整最终位置
// output_sequence的长度至少为10
static int adjust_final_position(int8_t final_state, char* output_sequence) {
    char state_str[3];
    bool l_arm, r_arm;
    int adjust_time = 0;
    decode_state(final_state, state_str, &l_arm, &r_arm);
    
    if (l_arm) {
        strcat(output_sequence, "L2 L+N L0 ");
        adjust_time = other_sequence_time.arm_back;
    }
    if (r_arm) {
        strcat(output_sequence, "R2 R+N R0 ");
        adjust_time = other_sequence_time.arm_back;
    }
    return adjust_time;
}

// 解决方案入口
int solution_to_motion(const char* initial_state, const char* action_str, char* output_sequence) 
{
    if(!time_data_init){
        ESP_LOGE(TAG, "需要先执行init_time_table");
    }
    int time = 0, adj_time = 0;
    int8_t final_state = 0;
    int8_t initial_state_int = encode_state(initial_state, false, false);
    output_sequence[0] = '\0';// 解决连续调用solution_to_motion会出现内存越界的BUG
    time = cube_tweak_str_time(initial_state_int, action_str, output_sequence, &final_state);
    if(time < 0){
        ESP_LOGE(TAG, "调用cube_tweak_str_time出错");
        return -1;
    }
    // 调整位置
    adj_time = adjust_final_position(final_state, output_sequence);
    return time + adj_time;
}
